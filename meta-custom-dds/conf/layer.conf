## meta-custom-dds/conf/layer.conf
```bitbake
# We have a conf and classes directory, add to BBPATH
BBPATH .= ":${LAYERDIR}"

# We have recipes-* directories, add to BBFILES
BBFILES += "${LAYERDIR}/recipes-*/*/*.bb \
            ${LAYERDIR}/recipes-*/*/*.bbappend"

BBFILE_COLLECTIONS += "meta-custom-dds"
BBFILE_PATTERN_meta-custom-dds = "^${LAYERDIR}/"
BBFILE_PRIORITY_meta-custom-dds = "6"

LAYERDEPENDS_meta-custom-dds = "core"
LAYERSERIES_COMPAT_meta-custom-dds = "walnascar"
```

## meta-iot-southbound/conf/layer.conf
```bitbake
# We have a conf and classes directory, add to BBPATH
BBPATH .= ":${LAYERDIR}"

# We have recipes-* directories, add to BBFILES
BBFILES += "${LAYERDIR}/recipes-*/*/*.bb \
            ${LAYERDIR}/recipes-*/*/*.bbappend"

BBFILE_COLLECTIONS += "meta-iot-southbound"
BBFILE_PATTERN_meta-iot-southbound = "^${LAYERDIR}/"
BBFILE_PRIORITY_meta-iot-southbound = "6"

LAYERDEPENDS_meta-iot-southbound = "core"
LAYERSERIES_COMPAT_meta-iot-southbound = "walnascar"
```

## meta-openigw/conf/layer.conf
```bitbake
# We have a conf and classes directory, add to BBPATH
BBPATH .= ":${LAYERDIR}"

# We have recipes-* directories, add to BBFILES
BBFILES += "${LAYERDIR}/recipes-*/*/*.bb \
            ${LAYERDIR}/recipes-*/*/*.bbappend"

BBFILE_COLLECTIONS += "meta-openigw"
BBFILE_PATTERN_meta-openigw = "^${LAYERDIR}/"
BBFILE_PRIORITY_meta-openigw = "6"

LAYERDEPENDS_meta-openigw = "core"
LAYERSERIES_COMPAT_meta-openigw = "walnascar"
```
